// Miryoku keymap for TOTEM — canonical engine vendored from
// https://github.com/manna-harbour/miryoku_zmk into config/miryoku/
// (must live inside config/: the build-user-config workflow copies only
// config/* into its isolated build dir when zephyr/module.yml is present).
// Variant selection lives in miryoku/custom_config.h.

#include "miryoku/custom_config.h"
#include "miryoku/mapping/38/totem.h"
#include "miryoku/miryoku.dtsi"
