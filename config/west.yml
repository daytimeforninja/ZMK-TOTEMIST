## config/west.yml
```yaml
manifest:
  remotes:
  - name: zmkfirmware
    url-base: https://github.com/zmkfirmware
  projects:
  - name: zmk
    remote: zmkfirmware
    revision: v0.3
    import: app/west.yml
  - name: zmk-keyboards-totem
    url: https://github.com/victorlucachi/zmk-keyboards-totem
    revision: 6b76bfb
    path: modules/zmk-keyboards-totem
  self:
    path: config
```
